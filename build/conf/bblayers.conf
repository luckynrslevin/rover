## build/conf/bblayers.conf
```bitbake
# POKY_BBLAYERS_CONF_VERSION is increased each time build/conf/bblayers.conf
# changes incompatibly
POKY_BBLAYERS_CONF_VERSION = "2"

BBPATH = "${TOPDIR}"
BBFILES ?= ""

BBLAYERS ?= " \
  ../src/poky/meta \
  ../src/meta-raspberrypi \
  ../src/meta-openembedded/meta-filesystems \
  ../src/meta-openembedded/meta-initramfs \
  ../src/meta-openembedded/meta-networking \
  ../src/meta-openembedded/meta-oe \
  ../src/meta-openembedded/meta-python \
  ../src/poky/meta-poky \
  ../src/poky/meta-yocto-bsp \
  ../src/meta-rpi \
  "
```
